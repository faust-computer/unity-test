## zephyr/Kconfig.unitytest
```kconfig
# Copyright (c) 2023 Faust Network, Inc

config LIBUNITYTEST
	bool "Enable unity test"
	help
	  This option enables the unity test library as a Zephyr module.
```
